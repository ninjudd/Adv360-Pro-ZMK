/*
*
* Copyright (c) 2021 Polarity Works
* SPDX-License-Identifier: MIT
*
*/

/* The custom layout lives in colemak.keymap so that
 * adv360.keymap stays identical to upstream and merges cleanly. */
#include "colemak.keymap"
